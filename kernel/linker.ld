ENTRY(protected_start)
SECTIONS
{
    . = 0x1000;
    .text : {
        *(.text*)
    }
    .rodata : {
        *(.rodata*)
    }
    .data : {
        *(.data*)
    }
    .bss : {
        *(.bss*)
        *(COMMON)
    }
    kernel_end = .;
}
